## Firmware/Kconfig.projbuild
```kconfig
menu "FlxOS Configuration"

    config FLXOS_PROFILE
        string "Device Profile ID"
        default ""
        help
            Profile folder name under Profiles/.
            Examples: cyd-2432s028r, esp32s3-ili9341-xpt, generic-esp32
            Run 'python flxos.py list' to see all available profiles.

    config FLXOS_HEADLESS_MODE
        bool "Headless Mode (No Display/GUI)"
        default n
        help
            Run FlxOS without display hardware or GUI.
            Disables LovyanGFX, LVGL, and all UI components.
            Automatically set when profile.yaml has headless: true.

    config FLXOS_CLI_ENABLED
        bool "Enable CLI (Command Line Interface)"
        default n
        help
            Enable interactive command-line interface via serial console.
            Provides system commands like sysinfo, heap, uptime, reboot.
            Works in both headless and GUI modes.

endmenu
```

## main/Kconfig.projbuild
```kconfig
menu "Hardware Configuration"

    config FLXOS_DISPLAY_WIDTH
        int "Display Width"
        default 240
        help
            The horizontal resolution of the display.

    config FLXOS_DISPLAY_HEIGHT
        int "Display Height"
        default 320
        help
            The vertical resolution of the display.

    config FLXOS_DISPLAY_ROTATION
        int "Display Rotation (0, 90, 180, 270)"
        range 0 270
        default 90
        help
            Initial rotation of the display in degrees.

    choice FLXOS_HARDWARE_MODE
        prompt "Hardware Initialization Mode"
        default FLXOS_HARDWARE_MANUAL
        help
            Choose between manual pin configuration or LovyanGFX AutoDetect.

        config FLXOS_HARDWARE_MANUAL
            bool "Manual Configuration"
            help
                Manually specify pins and drivers.

        config FLXOS_HARDWARE_AUTODETECT
            bool "AutoDetect (for known boards)"
            help
                Use LovyanGFX AutoDetect to find hardware at runtime.
    endchoice

    if FLXOS_HARDWARE_MANUAL
        menu "Display Driver Selection"
            choice FLXOS_DISPLAY_DRIVER
                prompt "Panel Driver"
                default FLXOS_DISPLAY_ILI9341
                
                config FLXOS_DISPLAY_ILI9163
                    bool "ILI9163"
                config FLXOS_DISPLAY_ILI9225
                    bool "ILI9225"
                config FLXOS_DISPLAY_ILI9341
                    bool "ILI9341"
                config FLXOS_DISPLAY_ILI9342
                    bool "ILI9342"
                config FLXOS_DISPLAY_ILI9481
                    bool "ILI9481"
                config FLXOS_DISPLAY_ILI9486
                    bool "ILI9486"
                config FLXOS_DISPLAY_ILI9488
                    bool "ILI9488"
                config FLXOS_DISPLAY_ST7735
                    bool "ST7735"
                config FLXOS_DISPLAY_ST7789
                    bool "ST7789"
                config FLXOS_DISPLAY_ST7796
                    bool "ST7796"
                config FLXOS_DISPLAY_GC9A01
                    bool "GC9A01 (Round)"
                config FLXOS_DISPLAY_SSD1306
                    bool "SSD1306 (OLED)"
                config FLXOS_DISPLAY_SSD1327
                    bool "SSD1327 (OLED)"
                config FLXOS_DISPLAY_SSD1331
                    bool "SSD1331 (OLED)"
                config FLXOS_DISPLAY_SSD1351
                    bool "SSD1351 (OLED)"
                config FLXOS_DISPLAY_SSD1963
                    bool "SSD1963"
                config FLXOS_DISPLAY_NT35510
                    bool "NT35510"
                config FLXOS_DISPLAY_RM68120
                    bool "RM68120"
                config FLXOS_DISPLAY_RA8875
                    bool "RA8875"
            endchoice

            config FLXOS_DISPLAY_INVERT
                bool "Invert Display Colors"
                default n

            config FLXOS_DISPLAY_RGB_ORDER
                bool "Is RGB Order? (N=BGR)"
                default n
        endmenu

        menu "Manual Pin Configuration"
            config FLXOS_SPI_HOST
                int "SPI Host (1=SPI2, 2=SPI3)"
                range 1 2
                default 1

            config FLXOS_SPI_FREQ_WRITE
                int "SPI Write Frequency (Hz)"
                default 40000000
                help
                    Default is 40MHz. Some displays support up to 80MHz.

            config FLXOS_SPI_FREQ_READ
                int "SPI Read Frequency (Hz)"
                default 16000000
                
            config FLXOS_PIN_SCLK
                int "SPI SCLK Pin"
                default 12
            
            config FLXOS_PIN_MOSI
                int "SPI MOSI Pin"
                default 11
            
            config FLXOS_PIN_MISO
                int "SPI MISO Pin"
                default 7
            
            config FLXOS_PIN_CS
                int "Display CS Pin"
                default 10
            
            config FLXOS_PIN_DC
                int "Display DC Pin"
                default 9
            
            config FLXOS_PIN_RST
                int "Display Reset Pin"
                default 15

            config FLXOS_PIN_BCKL
                int "Backlight Pin"
                default 17
            
            config FLXOS_BCKL_FREQ
                int "Backlight PWM Frequency (Hz)"
                default 20000

            config FLXOS_BCKL_PWM_CHANNEL
                int "Backlight PWM Channel"
                default 7

            config FLXOS_TOUCH_ENABLED
                bool "Enable Touch"
                default y

            if FLXOS_TOUCH_ENABLED
                choice FLXOS_TOUCH_DRIVER
                    prompt "Touch Driver"
                    default FLXOS_TOUCH_XPT2046
                    
                    config FLXOS_TOUCH_XPT2046
                        bool "XPT2046 (SPI)"
                    config FLXOS_TOUCH_FT5x06
                        bool "FT5x06 / FT6x36 (I2C)"
                    config FLXOS_TOUCH_GT911
                        bool "GT911 (I2C)"
                    config FLXOS_TOUCH_CSTxxx
                        bool "CSTxxx (I2C)"
                    config FLXOS_TOUCH_CHSC6x
                        bool "CHSC6x (I2C)"
                    config FLXOS_TOUCH_GSLx680
                        bool "GSLx680 (I2C)"
                    config FLXOS_TOUCH_NS2009
                        bool "NS2009 (I2C)"
                    config FLXOS_TOUCH_STMPE610
                        bool "STMPE610 (I2C)"
                endchoice

                config FLXOS_PIN_TOUCH_CS
                    int "Touch CS Pin (SPI only)"
                    default 8
                    depends on FLXOS_TOUCH_XPT2046
                
                config FLXOS_PIN_TOUCH_SCL
                    int "Touch I2C SCL Pin"
                    default 12
                    depends on !FLXOS_TOUCH_XPT2046 && !FLXOS_TOUCH_RA8875

                config FLXOS_PIN_TOUCH_SDA
                    int "Touch I2C SDA Pin"
                    default 11
                    depends on !FLXOS_TOUCH_XPT2046 && !FLXOS_TOUCH_RA8875

                config FLXOS_PIN_TOUCH_INT
                    int "Touch INT Pin"
                    default 16
            endif
        endmenu
    endif

endmenu
```

## sdkconfig.defaults.esp32
```kconfig
CONFIG_IDF_TARGET="esp32"
CONFIG_ESPTOOLPY_FLASHSIZE_4MB=y
CONFIG_PARTITION_TABLE_FILENAME="partitions_4mb.csv"
CONFIG_PARTITION_TABLE_CUSTOM_FILENAME="partitions_4mb.csv"

# Default CI profile: generic headless
CONFIG_FLXOS_HEADLESS_MODE=y
# CONFIG_FLXOS_PROFILE_NONE is not set
CONFIG_FLXOS_PROFILE_GENERIC_ESP32=y
```

## sdkconfig.defaults.esp32_cyd
```kconfig
# ESP32-2432S028R (Cheap Yellow Display / CYD) board preset
# Display: ILI9341 on HSPI, Touch: XPT2046 on Software SPI
# Copy this file to sdkconfig.defaults.esp32 before building.
#
# Reference: https://randomnerdtutorials.com/cheap-yellow-display-esp32-2432s028r/

CONFIG_IDF_TARGET="esp32"
CONFIG_ESPTOOLPY_FLASHSIZE_4MB=y
CONFIG_PARTITION_TABLE_FILENAME="partitions_4mb.csv"
CONFIG_PARTITION_TABLE_CUSTOM_FILENAME="partitions_4mb.csv"

# Display: ILI9341, 240x320
CONFIG_FLXOS_DISPLAY_ILI9341=y
CONFIG_FLXOS_DISPLAY_WIDTH=240
CONFIG_FLXOS_DISPLAY_HEIGHT=320
CONFIG_FLXOS_DISPLAY_ROTATION=90

# Display Bus: SPI (HSPI)
CONFIG_FLXOS_BUS_SPI=y
CONFIG_FLXOS_SPI_HOST=1
CONFIG_FLXOS_SPI_MODE=0
CONFIG_FLXOS_SPI_FREQ_WRITE=40000000
CONFIG_FLXOS_SPI_FREQ_READ=16000000
CONFIG_FLXOS_PIN_SCLK=14
CONFIG_FLXOS_PIN_MOSI=13
CONFIG_FLXOS_PIN_MISO=12
CONFIG_FLXOS_PIN_DC=2

# Display Panel
CONFIG_FLXOS_PIN_CS=15
CONFIG_FLXOS_PIN_RST=-1
CONFIG_FLXOS_PIN_BUSY=-1
CONFIG_FLXOS_BUS_SHARED=n
CONFIG_FLXOS_PANEL_OFFSET_ROTATION=2

# Backlight
CONFIG_FLXOS_PIN_BCKL=21

# Touch: XPT2046 on separate (software) SPI
CONFIG_FLXOS_TOUCH_ENABLED=y
CONFIG_FLXOS_TOUCH_XPT2046=y
CONFIG_FLXOS_TOUCH_SPI_FREQ=1000000
CONFIG_FLXOS_TOUCH_SPI_SEPARATE_PINS=y
CONFIG_FLXOS_TOUCH_SPI_HOST=-1
CONFIG_FLXOS_PIN_TOUCH_SCLK=25
CONFIG_FLXOS_PIN_TOUCH_MOSI=32
CONFIG_FLXOS_PIN_TOUCH_MISO=39
CONFIG_FLXOS_PIN_TOUCH_CS=33
CONFIG_FLXOS_PIN_TOUCH_INT=-1
CONFIG_FLXOS_TOUCH_BUS_SHARED=n

# Touch Calibration (CYD defaults)
CONFIG_FLXOS_TOUCH_X_MIN=300
CONFIG_FLXOS_TOUCH_X_MAX=3900
CONFIG_FLXOS_TOUCH_Y_MIN=3700
CONFIG_FLXOS_TOUCH_Y_MAX=200
CONFIG_FLXOS_TOUCH_OFFSET_ROTATION=0

# SD Card (Shared HSPI bus, CS=GPIO5)
CONFIG_FLXOS_SD_CARD_ENABLED=y
CONFIG_FLXOS_SD_MOUNT_POINT="/sdcard"
CONFIG_FLXOS_SD_PIN_CS=5
CONFIG_FLXOS_SD_PIN_MOSI=-1
CONFIG_FLXOS_SD_PIN_MISO=-1
CONFIG_FLXOS_SD_PIN_SCLK=-1
CONFIG_FLXOS_SD_SPI_HOST=1
CONFIG_FLXOS_SD_MAX_FREQ_KHZ=4000
```
